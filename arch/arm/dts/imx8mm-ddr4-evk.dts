// SPDX-License-Identifier: GPL-2.0+
 /*
  * Copyright 2018 NXP
  */

/dts-v1/;

#include "imx8mm-evk.dtsi"

/ {
	model = "NXP i.MX8MM DDR4 EVK with CYW43455 WIFI/BT board";
	compatible = "fsl,imx8mm-ddr4-evk", "fsl,imx8mm";
};

